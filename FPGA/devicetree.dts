// Copyright (C) Hiroki KURUMATANI
// This program is free software;
// you can redistribute it and/or modify it under the terms of the FreeBSD License.
// For details, see the License.txt file.

/dts-v1/;/plugin/;
/ {
	fragment@0 {
		target-path = "/amba/fpga-region0";

		__overlay__ {
			#address-cells = <0x1>;
			#size-cells = <0x1>;

			firmware-name = "IRQ.bin"; 

			irq-uio@43c10000 {
				compatible = "generic-uio";
				reg = <0x43c00000 0x1000>;
				interrupt-parent = <&intc>;
				interrupts = <0x0 0x1d 0x4>;
			};

		};
	} ;
} ;
